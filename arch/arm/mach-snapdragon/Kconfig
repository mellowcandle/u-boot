## arch/arm/mach-snapdragon/Kconfig
```kconfig
if ARCH_SNAPDRAGON

config SYS_SOC
	default "snapdragon"

choice
	prompt "Snapdragon board select"

config TARGET_DRAGONBOARD410C
	bool "96Boards Dragonboard 410C"
	select ARM64
	select OF_SEPARATE
	help
	  Support for 96Boards Dragonboard 410C. This board complies with
	  96Board Open Platform Specifications. Features:
	  - Qualcomm Snapdragon 410C SoC - APQ8016 (4xCortex A53, Adreno 306)
	  - 1GiB RAM
	  - 8GiB eMMC, uSD slot
	  - WiFi, Bluetooth and GPS module
	  - 2x Host, 1x Device USB port
	  - HDMI
	  - 20-pin low speed and 40-pin high speed expanders, 4 LED, 3 buttons
config TARGET_DRAGONBOARD410C_32B
	bool "96Boards Dragonboard 410C 32Bit"
	select CPU_V7A
	select SYS_CACHE_SHIFT_6
	select OF_EMBED
	help
	  Support for 96Boards Dragonboard 410C 32bit. This board complies with
	  96Board Open Platform Specifications. Features:
	  - Qualcomm Snapdragon 410C SoC - APQ8016 (4xCortex A53, Adreno 306)
	  - 1GiB RAM
	  - 8GiB eMMC, uSD slot
	  - WiFi, Bluetooth and GPS module
	  - 2x Host, 1x Device USB port
	  - HDMI
	  - 20-pin low speed and 40-pin high speed expanders, 4 LED, 3 buttons
config TARGET_DRAGONBOARD820C
	bool "96Boards Dragonboard 820C"
	select ARM64
	select OF_SEPARATE
	help
	  Support for 96Boards Dragonboard 820C. This board complies with
	  96Board Open Platform Specifications. Features:
	  - Qualcomm Snapdragon 820C SoC - APQ8096 (4xKyro CPU)
	  - 3GiB RAM
	  - 32GiB UFS drive

endchoice

source "board/qualcomm/dragonboard410c/Kconfig"
source "board/qualcomm/dragonboard410c_32b/Kconfig"
source "board/qualcomm/dragonboard820c/Kconfig"

endif
```

## dragonboard410c.its
```
/*
 * Dragonboard410c Image with Linux kernel & single DTB
 * Copyright 2018 Ramon Fried <ramon.fried@gmail.com>
 */

/dts-v1/;

/ {
	description = "Dragonboard410c Image with Linux kernel & Single DTB";
	#address-cells = <2>;

	images {
		kernel {
			description = "Linux kernel";
			data = /incbin/("./Image.gz");
			type = "kernel";
			arch = "arm64";
			os = "linux";
			compression = "gzip";
			load = <0x80080000>;
			entry = <0x80080000>;
			hash-1 {
				algo = "crc32";
			};
		};
		fdt-1 {
			description = "Flattened Device Tree blob";
			data = /incbin/("./apq8016-sbc.dtb");
			type = "flat_dt";
			arch = "arm64";
			load = <0x84000000>;
			compression = "none";
			hash-1 {
				algo = "crc32";
			};
		};
	};

	configurations {
		default = "conf-1";
		conf-1 {
			description = "Boot Linux kernel with FDT blob";
			kernel = "kernel";
			fdt = "fdt-1";
		};
	};
};
```

## net/Kconfig
```kconfig
#
# Network configuration
#

menuconfig NET
	bool "Networking support"
	default y

if NET

config NET_PCAP
	bool "PCAP network capture"
	help
	  Selecting this will capture all Ethernet packets and store
	  them in a PCAP formated file later to be analyzed by PCAP
	  reader application (IE. WireShark).

config NET_PCAP_ADDR
	hex "Address of PCAP file in memory"
	depends on NET_PCAP
	help
	  Sets the address of the PCAP file in physical memory.

config NET_PCAP_SIZE
	hex "Size of PCAP file"
	depends on NET_PCAP
	default 0x100000
	help
	  Sets the maximum size of PCAP file in bytes.
	  When it fills up completly, it will stop capturing
	  packets silently.

config NET_RANDOM_ETHADDR
	bool "Random ethaddr if unset"
	help
	  Selecting this will allow the Ethernet interface to function
	  even when the ethaddr variable for that interface is unset.
	  A new MAC address will be generated on every boot and it will
	  not be added to the environment.

config NETCONSOLE
	bool "NetConsole support"
	help
	  Support the 'nc' input/output device for networked console.
	  See README.NetConsole for details.

endif   # if NET
```
